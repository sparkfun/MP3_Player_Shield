/*
 3-16-2011
 Spark Fun Electronics 2011
 Nathan Seidle
 
 This code is public domain but you buy me a beer if you use this and we meet someday (Beerware license).
 
 This code works with the MP3 Shield based on the VS1053 IC: https://www.sparkfun.com/products/10628
 Attach the shield, attach head phones, load code, and you should hear 'Hello' four times. Debugging is done at 115200bps.
 
 This code doesn't require an SD card because it has the MP3 data embedded in the sketch.
 
 This code is heavily based on Rui's example code. Nice work Rui! You got me up and running. I just made some
 low level improvements. http://macauadventure.com/robotics/arduino/hello_world_2.pde
 
 There is a lot of comments here because these are all the gotchas I found using the VS1053.
 
 The flow of data is controlled by two pins:
 xDCS: Pull low to send data
 xCS: Pull low to send control commands
 From now on, xCS (aka *CS) will be called CS. The x just means it's active low which will be taken care of in firmware.
 
 We can also remove the need for DCS by setting SM_SDISHARE = 1. DCS signal is internally generated by 
 inverting CS input. However, if we want to hook up an external SD card, this is a bad idea. The reason is that
 if we combine the two pins (CS and DCS) then we always have to be in one of the modes (either data or control). 
 This is bad since we need to get the VS1053 off the SPI bus so we can go grab data bytes from the SD card. 
 
 Four pins are needed to control the VS1503:
 DREQ
 CS
 DCS
 Reset (optional but good to have access to)
 Plus the SPI bus
 
 Please make sure of what version of the MP3 shield you have:
 1) Shield with VS1033 may not work with this code
 2) Shield with VS1053 works with this code but requires the TX and RX traces to be cut in order to boot load an Arduino
 3) This code works best with the newest MP3 shield with VS1053 and SD combination: https://www.sparkfun.com/products/10628
 
 SCI: Pull XCS low to send a command to the VS1053. When a new SCI operation is sent
 the VS1053 pulls DREQ low. We then have to wait for VS1053 to let DREQ go high again.
 SCI consists of instruction byte, address byte, and 16-bit data word.
 XCS should be low for the full duration of operation.
 
 Size of audio FIFO is 2048 stereo (2x16 bit) samples. If DREQ is high, VS1053B can take, at a minimum, 
 32 bytes of SDI data. DREQ is low when stream buffer is full.
 
 The max SPI frequency of the VS1053 upon start up is 1.75MHz.
 From the datasheet: "Max SDI clock freq = CLKI/7 and CLKI = 12.288", hence the max
 clock = 1.75MHz. Page 10, input clock is 12.288MHz. Internal clock multiplier 
 is 1x after power up. Therefore, max SPI speed is 1.75MHz. We will use 1MHz to be safe. Once we are up
 and running, we increase the clock multiplier to 3x and increase SPI speed to 4MHz.
 
 Be cautious when using Serial.println() for debugging. I got a lot of random behavior when trying to
 do prints at different times.

*/

#include <SPI.h>

#define MP3_XCS 9 //Control Chip Select Pin (for accessing SPI Control/Status registers)
#define MP3_XDCS 2 //Data Chip Select / BSYNC Pin
#define MP3_DREQ 3 //Data Request Pin: Player asks for more data

//VS10xx SCI Registers
#define SCI_MODE 0x00
#define SCI_STATUS 0x01
#define SCI_BASS 0x02
#define SCI_CLOCKF 0x03
#define SCI_DECODE_TIME 0x04
#define SCI_AUDATA 0x05
#define SCI_WRAM 0x06
#define SCI_WRAMADDR 0x07
#define SCI_HDAT0 0x08
#define SCI_HDAT1 0x09
#define SCI_AIADDR 0x0A
#define SCI_VOL 0x0B
#define SCI_AICTRL0 0x0C
#define SCI_AICTRL1 0x0D
#define SCI_AICTRL2 0x0E
#define SCI_AICTRL3 0x0F

//Write to VS10xx register
//SCI: Data transfers are always 16bit. When a new SCI operation comes in 
//DREQ goes low. We then have to wait for DREQ to go high again.
//XCS should be low for the full duration of operation.
void Mp3WriteRegister(unsigned char addressbyte, unsigned char highbyte, unsigned char lowbyte){
  while(!digitalRead(MP3_DREQ)) ; //Wait for DREQ to go high indicating IC is available
  digitalWrite(MP3_XCS, LOW); //Select control

  //SCI consists of instruction byte, address byte, and 16-bit data word.
  SPI.transfer(0x02); //Write instruction
  SPI.transfer(addressbyte);
  SPI.transfer(highbyte);
  SPI.transfer(lowbyte);
  while(!digitalRead(MP3_DREQ)) ; //Wait for DREQ to go high indicating command is complete
  digitalWrite(MP3_XCS, HIGH); //Deselect Control
}

//Read the 16-bit value of a VS10xx register
unsigned int Mp3ReadRegister (unsigned char addressbyte){
  while(!digitalRead(MP3_DREQ)) ; //Wait for DREQ to go high indicating IC is available
  digitalWrite(MP3_XCS, LOW); //Select control

  //SCI consists of instruction byte, address byte, and 16-bit data word.
  SPI.transfer(0x03); //Read instruction
  SPI.transfer(addressbyte);

  char response1 = SPI.transfer(0xFF); //Read the first byte
  while(!digitalRead(MP3_DREQ)) ; //Wait for DREQ to go high indicating command is complete
  char response2 = SPI.transfer(0xFF); //Read the second byte
  while(!digitalRead(MP3_DREQ)) ; //Wait for DREQ to go high indicating command is complete

  digitalWrite(MP3_XCS, HIGH); //Deselect Control

  int resultvalue = response1 << 8;
  resultvalue |= response2;
  return resultvalue;
}

//Set VS10xx Volume Register
void Mp3SetVolume(unsigned char leftchannel, unsigned char rightchannel){
  Mp3WriteRegister(SCI_VOL, leftchannel, rightchannel);
}

unsigned char HelloMP3[] = {
  0xFF,0xF2,0x40,0xC0,0x19,0xB7,0x00,0x14,0x02,0xE6,0x5C, /* ..@.......\ */
  0x01,0x92,0x68,0x01,0xF1,0x5E,0x03,0x08,0xF0,0x24,0x80, /* ..h..^...$. */
  0x05,0x9E,0x20,0xC6,0xFC,0x12,0x32,0x5C,0xBF,0xF9,0xB9, /* .. ...2\... */
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  0x00, /* . */
};

void setup() {
  pinMode(MP3_DREQ, INPUT);
  pinMode(MP3_XCS, OUTPUT);
  pinMode(MP3_XDCS, OUTPUT);

  //These lines are needed for a proto type version of the MP3 shield. You shouldn't need them
  //----
  pinMode(6, OUTPUT);
  digitalWrite(6, HIGH);
  //----

  Serial.begin(115200); //Use serial for debugging 
  Serial.println("MP3 Shield Example");

  //Setup SPI for VS1053
  pinMode(10, OUTPUT); //Pin 10 must be set as an output for the SPI communication to work
  SPI.begin();
  SPI.setBitOrder(MSBFIRST);
  SPI.setDataMode(SPI_MODE0);

  //From page 12 of datasheet, max SCI reads are CLKI/7. Input clock is 12.288MHz. 
  //Internal clock multiplier is 1.0x after power up. 
  //Therefore, max SPI speed is 1.75MHz. We will use 1MHz to be safe.
  SPI.setClockDivider(SPI_CLOCK_DIV16); //Set SPI bus speed to 1MHz (16MHz / 16 = 1MHz)
  SPI.transfer(0xFF); //Throw a dummy byte at the bus

  //Initialize VS1053 chip 
  digitalWrite(MP3_XCS, HIGH); //Deselect Control
  digitalWrite(MP3_XDCS, HIGH); //Deselect Data

  Mp3SetVolume(20, 20); //Set initial volume (20 = -10dB)

  //Let's check the status of the VS1053
  int MP3Mode = Mp3ReadRegister(SCI_MODE);
  int MP3Status = Mp3ReadRegister(SCI_STATUS);
  int MP3Clock = Mp3ReadRegister(SCI_CLOCKF);

  Serial.print("SCI_Mode (0x4800) = 0x");
  Serial.println(MP3Mode, HEX);

  //Serial.print("SCI_Status (0x48) = 0x");
  //Serial.println(MP3Status, HEX);

  int vsVersion = (MP3Status >> 4) & 0x000F; //Mask out only the four version bits
  Serial.print("VS Version (VS1053 is 4) = ");
  Serial.println(vsVersion, DEC); //The 1053B should respond with 4. VS1001 = 0, VS1011 = 1, VS1002 = 2, VS1003 = 3

  //Serial.print("SCI_ClockF = 0x");
  //Serial.println(MP3Clock, HEX);

  //Now that we have the VS1053 up and running, increase the VS1053 internal clock multiplier and up our SPI rate
  Mp3WriteRegister(SCI_CLOCKF, 0x60, 0x00); //Set multiplier to 3.0x

  //From page 12 of datasheet, max SCI reads are CLKI/7. Input clock is 12.288MHz. 
  //Internal clock multiplier is now 3x.
  //Therefore, max SPI speed is 5MHz. 4MHz will be safe.
  SPI.setClockDivider(SPI_CLOCK_DIV4); //Set SPI bus speed to 4MHz (16MHz / 4 = 4MHz)

  MP3Clock = Mp3ReadRegister(SCI_CLOCKF);
  Serial.print("SCI_ClockF = 0x");
  Serial.println(MP3Clock, HEX);
}

void loop(){

  unsigned char *p;

  for(int x = 0 ; x < 4 ; x++) {

    p = &HelloMP3[0]; // Point "p" to the beginning of array
    while(p <= &HelloMP3[sizeof(HelloMP3) - 1]) {
      while(!digitalRead(MP3_DREQ)) { 
        //DREQ is low while the receive buffer is full
        //You can do something else here, the bus is free...
        //Maybe set the volume or whatever...
      }

      //Once DREQ is released (high) we can now send 32 bytes of data
      digitalWrite(MP3_XDCS, LOW); //Select Data
      SPI.transfer(*p++); // Send SPI byte
      digitalWrite(MP3_XDCS, HIGH); //Deselect Data
    }

    //End of file - send 2048 zeros before next file
    digitalWrite(MP3_XDCS, LOW); //Select Data
    for (int i = 0 ; i < 2048 ; i++) {
      while(!digitalRead(MP3_DREQ)); //If we ever see DREQ low, then we wait here
      SPI.transfer(0);
    }
    while(!digitalRead(MP3_DREQ)) ; //Wait for DREQ to go high indicating transfer is complete
    digitalWrite(MP3_XDCS, HIGH); //Deselect Data
  }

  Serial.println("Done!");
  while(1);
}

